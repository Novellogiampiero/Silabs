## CMakeLists.txt
```
# SPDX-License-Identifier: Apache-2.0

cmake_minimum_required(VERSION 3.20.0)

find_package(Zephyr REQUIRED HINTS $ENV{ZEPHYR_BASE})
project(trx)
find_package(Zephyr REQUIRED HINTS $ENV{ZEPHYR_BASE})
project(central_and_peripheral_autec)
#direttive di complialzione
#set(SL_COMPONENT_CATALOG_PRESENT 1) 
#'-DEFR32ZG23B020F512IM48=1' '-DSL_BOARD_NAME="BRD4210A"' '-DSL_BOARD_REV="A01"' '-DHARDWARE_BOARD_DEFAULT_RF_BAND_868=1' '-DHARDWARE_BOARD_SUPPORTS_2_RF_BANDS=1' '-DHARDWARE_BOARD_SUPPORTS_RF_BAND_868=1' '-DHARDWARE_BOARD_SUPPORTS_RF_BAND_915=1' '-DHFXO_FREQ=39000000' '-DSL_CLOCK_MANAGER_AUTO_BAND_VALID=1' '-DSL_COMPONENT_CATALOG_PRESENT=1' '-DCMSIS_NVIC_VIRTUAL=1' '-DCMSIS_NVIC_VIRTUAL_HEADER_FILE="cmsis_nvic_virtual.h"' '-DSL_RAIL_LIB_MULTIPROTOCOL_SUPPORT=0' '-DSL_RAIL_UTIL_PA_CONFIG_HEADER=<sl_rail_util_pa_config.h>' '-DSL_CODE_COMPONENT_CORE=core' -I"/home/novello/SimplicityStudio/v5_workspace/rail_soc_simple_trx_auto_ack/config" -I"/home/novello/SimplicityStudio/v5_workspace/rail_soc_simple_trx_auto_ack/config/rail" -I"/home/novello/SimplicityStudio/v5_workspace/rail_soc_simple_trx_auto_ack/autogen" -I"/home/novello/SimplicityStudio/v5_workspace/rail_soc_simple_trx_auto_ack" -I"/home/novello/SimplicityStudio/v5_workspace/rail_soc_simple_trx_auto_ack/simplicity_sdk_2024.6.1/platform/Device/SiliconLabs/EFR32ZG23/Include" -I"/home/novello/SimplicityStudio/v5_workspace/rail_soc_simple_trx_auto_ack/simplicity_sdk_2024.6.1/app/common/util/app_assert" -I"/home/novello/SimplicityStudio/v5_workspace/rail_soc_simple_trx_auto_ack/simplicity_sdk_2024.6.1/app/common/util/app_log" -I"/home/novello/SimplicityStudio/v5_workspace/rail_soc_simple_trx_auto_ack/simplicity_sdk_2024.6.1/platform/common/inc" -I"/home/novello/SimplicityStudio/v5_workspace/rail_soc_simple_trx_auto_ack/simplicity_sdk_2024.6.1/hardware/board/inc" -I"/home/novello/SimplicityStudio/v5_workspace/rail_soc_simple_trx_auto_ack/simplicity_sdk_2024.6.1/platform/driver/button/inc" -I"/home/novello/SimplicityStudio/v5_workspace/rail_soc_simple_trx_auto_ack/simplicity_sdk_2024.6.1/platform/service/cli/inc" -I"/home/novello/SimplicityStudio/v5_workspace/rail_soc_simple_trx_auto_ack/simplicity_sdk_2024.6.1/platform/service/cli/src" -I"/home/novello/SimplicityStudio/v5_workspace/rail_soc_simple_trx_auto_ack/simplicity_sdk_2024.6.1/platform/service/clock_manager/inc" -I"/home/novello/SimplicityStudio/v5_workspace/rail_soc_simple_trx_auto_ack/simplicity_sdk_2024.6.1/platform/service/clock_manager/src" -I"/home/novello/SimplicityStudio/v5_workspace/rail_soc_simple_trx_auto_ack/simplicity_sdk_2024.6.1/platform/CMSIS/Core/Include" -I"/home/novello/SimplicityStudio/v5_workspace/rail_soc_simple_trx_auto_ack/simplicity_sdk_2024.6.1/hardware/driver/configuration_over_swo/inc" -I"/home/novello/SimplicityStudio/v5_workspace/rail_soc_simple_trx_auto_ack/simplicity_sdk_2024.6.1/platform/driver/debug/inc" -I"/home/novello/SimplicityStudio/v5_workspace/rail_soc_simple_trx_auto_ack/simplicity_sdk_2024.6.1/platform/service/device_manager/inc" -I"/home/novello/SimplicityStudio/v5_workspace/rail_soc_simple_trx_auto_ack/simplicity_sdk_2024.6.1/platform/service/device_init/inc" -I"/home/novello/SimplicityStudio/v5_workspace/rail_soc_simple_trx_auto_ack/simplicity_sdk_2024.6.1/platform/emdrv/dmadrv/inc" -I"/home/novello/SimplicityStudio/v5_workspace/rail_soc_simple_trx_auto_ack/simplicity_sdk_2024.6.1/platform/emdrv/dmadrv/inc/s2_signals" -I"/home/novello/SimplicityStudio/v5_workspace/rail_soc_simple_trx_auto_ack/simplicity_sdk_2024.6.1/platform/emdrv/common/inc" -I"/home/novello/SimplicityStudio/v5_workspace/rail_soc_simple_trx_auto_ack/simplicity_sdk_2024.6.1/platform/emlib/inc" -I"/home/novello/SimplicityStudio/v5_workspace/rail_soc_simple_trx_auto_ack/simplicity_sdk_2024.6.1/platform/emdrv/gpiointerrupt/inc" -I"/home/novello/SimplicityStudio/v5_workspace/rail_soc_simple_trx_auto_ack/simplicity_sdk_2024.6.1/platform/service/interrupt_manager/inc" -I"/home/novello/SimplicityStudio/v5_workspace/rail_soc_simple_trx_auto_ack/simplicity_sdk_2024.6.1/platform/service/interrupt_manager/inc/arm" -I"/home/novello/SimplicityStudio/v5_workspace/rail_soc_simple_trx_auto_ack/simplicity_sdk_2024.6.1/platform/service/iostream/inc" -I"/home/novello/SimplicityStudio/v5_workspace/rail_soc_simple_trx_auto_ack/simplicity_sdk_2024.6.1/platform/driver/leddrv/inc" -I"/home/novello/SimplicityStudio/v5_workspace/rail_soc_simple_trx_auto_ack/simplicity_sdk_2024.6.1/platform/service/memory_manager/inc" -I"/home/novello/SimplicityStudio/v5_workspace/rail_soc_simple_trx_auto_ack/simplicity_sdk_2024.6.1/platform/service/mpu/inc" -I"/home/novello/SimplicityStudio/v5_workspace/rail_soc_simple_trx_auto_ack/simplicity_sdk_2024.6.1/hardware/driver/mx25_flash_shutdown/inc/sl_mx25_flash_shutdown_usart" -I"/home/novello/SimplicityStudio/v5_workspace/rail_soc_simple_trx_auto_ack/simplicity_sdk_2024.6.1/util/third_party/printf" -I"/home/novello/SimplicityStudio/v5_workspace/rail_soc_simple_trx_auto_ack/simplicity_sdk_2024.6.1/util/third_party/printf/inc" -I"/home/novello/SimplicityStudio/v5_workspace/rail_soc_simple_trx_auto_ack/simplicity_sdk_2024.6.1/platform/radio/rail_lib/common" -I"/home/novello/SimplicityStudio/v5_workspace/rail_soc_simple_trx_auto_ack/simplicity_sdk_2024.6.1/platform/radio/rail_lib/protocol/ble" -I"/home/novello/SimplicityStudio/v5_workspace/rail_soc_simple_trx_auto_ack/simplicity_sdk_2024.6.1/platform/radio/rail_lib/protocol/ieee802154" -I"/home/novello/SimplicityStudio/v5_workspace/rail_soc_simple_trx_auto_ack/simplicity_sdk_2024.6.1/platform/radio/rail_lib/protocol/wmbus" -I"/home/novello/SimplicityStudio/v5_workspace/rail_soc_simple_trx_auto_ack/simplicity_sdk_2024.6.1/platform/radio/rail_lib/protocol/zwave" -I"/home/novello/SimplicityStudio/v5_workspace/rail_soc_simple_trx_auto_ack/simplicity_sdk_2024.6.1/platform/radio/rail_lib/chip/efr32/efr32xg2x" -I"/home/novello/SimplicityStudio/v5_workspace/rail_soc_simple_trx_auto_ack/simplicity_sdk_2024.6.1/platform/radio/rail_lib/protocol/sidewalk" -I"/home/novello/SimplicityStudio/v5_workspace/rail_soc_simple_trx_auto_ack/simplicity_sdk_2024.6.1/platform/radio/rail_lib/plugin/rail_util_callbacks" -I"/home/novello/SimplicityStudio/v5_workspace/rail_soc_simple_trx_auto_ack/simplicity_sdk_2024.6.1/platform/radio/rail_lib/plugin/pa-conversions" -I"/home/novello/SimplicityStudio/v5_workspace/rail_soc_simple_trx_auto_ack/simplicity_sdk_2024.6.1/platform/radio/rail_lib/plugin/pa-conversions/efr32xg23" -I"/home/novello/SimplicityStudio/v5_workspace/rail_soc_simple_trx_auto_ack/simplicity_sdk_2024.6.1/platform/radio/rail_lib/plugin/rail_util_protocol" -I"/home/novello/SimplicityStudio/v5_workspace/rail_soc_simple_trx_auto_ack/simplicity_sdk_2024.6.1/platform/radio/rail_lib/plugin/rail_util_pti" -I"/home/novello/SimplicityStudio/v5_workspace/rail_soc_simple_trx_auto_ack/simplicity_sdk_2024.6.1/platform/radio/rail_lib/plugin/rail_util_rssi" -I"/home/novello/SimplicityStudio/v5_workspace/rail_soc_simple_trx_auto_ack/simplicity_sdk_2024.6.1/app/flex/component/rail/simple_rail_assistance" -I"/home/novello/SimplicityStudio/v5_workspace/rail_soc_simple_trx_auto_ack/simplicity_sdk_2024.6.1/app/flex/component/rail/sl_flex_rail_channel_selector" -I"/home/novello/SimplicityStudio/v5_workspace/rail_soc_simple_trx_auto_ack/simplicity_sdk_2024.6.1/app/flex/component/rail/sl_flex_rail_package_assistant" -I"/home/novello/SimplicityStudio/v5_workspace/rail_soc_simple_trx_auto_ack/simplicity_sdk_2024.6.1/app/flex/component/rail/sl_flex_rail_packet_asm" -I"/home/novello/SimplicityStudio/v5_workspace/rail_soc_simple_trx_auto_ack/simplicity_sdk_2024.6.1/platform/common/toolchain/inc" -I"/home/novello/SimplicityStudio/v5_workspace/rail_soc_simple_trx_auto_ack/simplicity_sdk_2024.6.1/platform/service/system/inc" -I"/home/novello/SimplicityStudio/v5_workspace/rail_soc_simple_trx_auto_ack/simplicity_sdk_2024.6.1/platform/service/udelay/inc" -Og -Wall -Wextra -ffunction-sections -fdata-sections -imacrossl_gcc_preinclude.h -mfpu=fpv5-sp-d16 -mfloat-abi=hard -mcmse -fno-builtin-printf -fno-builtin-sprintf --specs=nano.specs -c -fmessage-length=0 -MMD -MP -MF"autogen/sl_simple_led_instances.d" -MT"autogen/sl_simple_led_instances.o" -o "autogen/sl_simple_led_instances.o" "../autogen/sl_simple_led_instances.c"
#-Wall -Wformat -Wformat-security -Wno-format-zero-length -Wdouble-promotion -Wno-pointer-sign -Wpointer-arith -Wexpansion-t     o-defined -Wno-unused-but-set-variable -Werror=implicit-int -fno-pic -fno-pie -fno-asynchronous-unwind-tables -fno-reorder-functions --param=min-pagesize=0 -fno-defer-pop -fmacro-prefix-map=/home/novello/zephyr3.7B/R5x_No/autec-dir/samples/trx3=CMAKE_SOURCE_DIR -fmacro-prefix-map=/home/novello/zephyr3.7B/R5x_No/zephyr=ZEPHYR_BASE -fmacro-prefix-map=/home/novello/zephyr3.7B/R5x_No=WEST_TOPDIR -ffunction-sections -fdata-sections -D_POSIX_THREADS -std=c99 -nostdinc -MD -MT zephyr/CMakeFiles/zephyr.dir/misc/generated/configs.c.obj -MF zephyr/CMakeFiles/zephyr.dir/misc/generated/configs.c.obj.d -o zephyr/CMakeFiles/zephyr.dir/misc/generated/configs.c.obj -c /home/novello/zephyr3.7B/R5x_No/autec-dir/samples/trx3/build/zephyr/misc/generated/configs.c

#

#add_definitions(SL_COMPONENT_CATALOG_PRESENT=1)
add_compile_options("-g -gdwarf-2 -mcpu=cortex-m33 -mthumb -std=c18 -Wall" "-Wpedantic" "-Wextra" "-fexceptions" "$<$<CONFIG:DEBUG>:-O0;-g3;-ggdb>")
#gcc -g -gdwarf-2 -mcpu=cortex-m33 -mthumb -std=c18

target_include_directories(app PUBLIC
    src/
    src/autogen/
    src/config/
    src/config/rail
    src/config/rail/${CONFIG_BOARD}
    src/autogen/config/rail/${CONFIG_BOARD}
    src/autogen/rail/${CONFIG_BOARD}
    /home/novello/zephyr3.7B/simplicity_sdk/platform/radio/rail_lib/plugin/rail_util_rssi
    /home/novello/zephyr3.7B/simplicity_sdk/hardware/board/inc
    /home/novello/zephyr3.7B/simplicity_sdk/platform/service/mpu/inc
    /home/novello/zephyr3.7B/simplicity_sdk/hardware/driver/configuration_over_swo/inc/sl_cos.h
)

target_sources(app PRIVATE src/main.c)
target_sources(app PRIVATE src/app_init.c)
target_sources(app PRIVATE src/app_cli.c)
target_sources(app PRIVATE src/app_gpio.c)
target_sources(app PRIVATE src/app_process.c)
target_sources(app PRIVATE src/autogen/sl_cli_command_table.c)
target_sources(app PRIVATE src/autogen/sl_board_default_init.c)
target_sources(app PRIVATE src/autogen/rail_config.c)
target_sources(app PRIVATE src/autogen/sl_cli_instances.c)
target_sources(app PRIVATE src/autogen/sl_event_handler.c)
target_sources(app PRIVATE src/autogen/sli_cli_hooks.c)
target_sources(app PRIVATE src/autogen/sl_rail_util_callbacks.c)
target_sources(app PRIVATE src/autogen/sl_rail_util_init.c)



#arm-none-eabi-gcc -g -gdwarf-2 -mcpu=cortex-m33 -mthumb -std=c18 '-DEFR32ZG23B020F512IM48=1' '-DSL_BOARD_NAME="BRD4210A"' '-DSL_BOARD_REV="A01"' '-DHARDWARE_BOARD_DEFAULT_RF_BAND_868=1' '-DHARDWARE_BOARD_SUPPORTS_2_RF_BANDS=1' '-DHARDWARE_BOARD_SUPPORTS_RF_BAND_868=1' '-DHARDWARE_BOARD_SUPPORTS_RF_BAND_915=1' '-DHFXO_FREQ=39000000' '-DSL_CLOCK_MANAGER_AUTO_BAND_VALID=1' '-DSL_COMPONENT_CATALOG_PRESENT=1' '-DCMSIS_NVIC_VIRTUAL=1' '-DCMSIS_NVIC_VIRTUAL_HEADER_FILE="cmsis_nvic_virtual.h"' '-DSL_RAIL_LIB_MULTIPROTOCOL_SUPPORT=0' '-DSL_RAIL_UTIL_PA_CONFIG_HEADER=<sl_rail_util_pa_config.h>' '-DSL_CODE_COMPONENT_CORE=core' -I"/home/novello/SimplicityStudio/v5_workspace/rail_soc_simple_trx_auto_ack/config" -I"/home/novello/SimplicityStudio/v5_workspace/rail_soc_simple_trx_auto_ack/config/rail" -I"/home/novello/SimplicityStudio/v5_workspace/rail_soc_simple_trx_auto_ack/autogen" -I"/home/novello/SimplicityStudio/v5_workspace/rail_soc_simple_trx_auto_ack" -I"/home/novello/SimplicityStudio/v5_workspace/rail_soc_simple_trx_auto_ack/simplicity_sdk_2024.6.1/platform/Device/SiliconLabs/EFR32ZG23/Include" -I"/home/novello/SimplicityStudio/v5_workspace/rail_soc_simple_trx_auto_ack/simplicity_sdk_2024.6.1/app/common/util/app_assert" -I"/home/novello/SimplicityStudio/v5_workspace/rail_soc_simple_trx_auto_ack/simplicity_sdk_2024.6.1/app/common/util/app_log" -I"/home/novello/SimplicityStudio/v5_workspace/rail_soc_simple_trx_auto_ack/simplicity_sdk_2024.6.1/platform/common/inc" -I"/home/novello/SimplicityStudio/v5_workspace/rail_soc_simple_trx_auto_ack/simplicity_sdk_2024.6.1/hardware/board/inc" -I"/home/novello/SimplicityStudio/v5_workspace/rail_soc_simple_trx_auto_ack/simplicity_sdk_2024.6.1/platform/driver/button/inc" -I"/home/novello/SimplicityStudio/v5_workspace/rail_soc_simple_trx_auto_ack/simplicity_sdk_2024.6.1/platform/service/cli/inc" -I"/home/novello/SimplicityStudio/v5_workspace/rail_soc_simple_trx_auto_ack/simplicity_sdk_2024.6.1/platform/service/cli/src" -I"/home/novello/SimplicityStudio/v5_workspace/rail_soc_simple_trx_auto_ack/simplicity_sdk_2024.6.1/platform/service/clock_manager/inc" -I"/home/novello/SimplicityStudio/v5_workspace/rail_soc_simple_trx_auto_ack/simplicity_sdk_2024.6.1/platform/service/clock_manager/src" -I"/home/novello/SimplicityStudio/v5_workspace/rail_soc_simple_trx_auto_ack/simplicity_sdk_2024.6.1/platform/CMSIS/Core/Include" -I"/home/novello/SimplicityStudio/v5_workspace/rail_soc_simple_trx_auto_ack/simplicity_sdk_2024.6.1/hardware/driver/configuration_over_swo/inc" -I"/home/novello/SimplicityStudio/v5_workspace/rail_soc_simple_trx_auto_ack/simplicity_sdk_2024.6.1/platform/driver/debug/inc" -I"/home/novello/SimplicityStudio/v5_workspace/rail_soc_simple_trx_auto_ack/simplicity_sdk_2024.6.1/platform/service/device_manager/inc" -I"/home/novello/SimplicityStudio/v5_workspace/rail_soc_simple_trx_auto_ack/simplicity_sdk_2024.6.1/platform/service/device_init/inc" -I"/home/novello/SimplicityStudio/v5_workspace/rail_soc_simple_trx_auto_ack/simplicity_sdk_2024.6.1/platform/emdrv/dmadrv/inc" -I"/home/novello/SimplicityStudio/v5_workspace/rail_soc_simple_trx_auto_ack/simplicity_sdk_2024.6.1/platform/emdrv/dmadrv/inc/s2_signals" -I"/home/novello/SimplicityStudio/v5_workspace/rail_soc_simple_trx_auto_ack/simplicity_sdk_2024.6.1/platform/emdrv/common/inc" -I"/home/novello/SimplicityStudio/v5_workspace/rail_soc_simple_trx_auto_ack/simplicity_sdk_2024.6.1/platform/emlib/inc" -I"/home/novello/SimplicityStudio/v5_workspace/rail_soc_simple_trx_auto_ack/simplicity_sdk_2024.6.1/platform/emdrv/gpiointerrupt/inc" -I"/home/novello/SimplicityStudio/v5_workspace/rail_soc_simple_trx_auto_ack/simplicity_sdk_2024.6.1/platform/service/interrupt_manager/inc" -I"/home/novello/SimplicityStudio/v5_workspace/rail_soc_simple_trx_auto_ack/simplicity_sdk_2024.6.1/platform/service/interrupt_manager/inc/arm" -I"/home/novello/SimplicityStudio/v5_workspace/rail_soc_simple_trx_auto_ack/simplicity_sdk_2024.6.1/platform/service/iostream/inc" -I"/home/novello/SimplicityStudio/v5_workspace/rail_soc_simple_trx_auto_ack/simplicity_sdk_2024.6.1/platform/driver/leddrv/inc" -I"/home/novello/SimplicityStudio/v5_workspace/rail_soc_simple_trx_auto_ack/simplicity_sdk_2024.6.1/platform/service/memory_manager/inc" -I"/home/novello/SimplicityStudio/v5_workspace/rail_soc_simple_trx_auto_ack/simplicity_sdk_2024.6.1/platform/service/mpu/inc" -I"/home/novello/SimplicityStudio/v5_workspace/rail_soc_simple_trx_auto_ack/simplicity_sdk_2024.6.1/hardware/driver/mx25_flash_shutdown/inc/sl_mx25_flash_shutdown_usart" -I"/home/novello/SimplicityStudio/v5_workspace/rail_soc_simple_trx_auto_ack/simplicity_sdk_2024.6.1/util/third_party/printf" -I"/home/novello/SimplicityStudio/v5_workspace/rail_soc_simple_trx_auto_ack/simplicity_sdk_2024.6.1/util/third_party/printf/inc" -I"/home/novello/SimplicityStudio/v5_workspace/rail_soc_simple_trx_auto_ack/simplicity_sdk_2024.6.1/platform/radio/rail_lib/common" -I"/home/novello/SimplicityStudio/v5_workspace/rail_soc_simple_trx_auto_ack/simplicity_sdk_2024.6.1/platform/radio/rail_lib/protocol/ble" -I"/home/novello/SimplicityStudio/v5_workspace/rail_soc_simple_trx_auto_ack/simplicity_sdk_2024.6.1/platform/radio/rail_lib/protocol/ieee802154" -I"/home/novello/SimplicityStudio/v5_workspace/rail_soc_simple_trx_auto_ack/simplicity_sdk_2024.6.1/platform/radio/rail_lib/protocol/wmbus" -I"/home/novello/SimplicityStudio/v5_workspace/rail_soc_simple_trx_auto_ack/simplicity_sdk_2024.6.1/platform/radio/rail_lib/protocol/zwave" -I"/home/novello/SimplicityStudio/v5_workspace/rail_soc_simple_trx_auto_ack/simplicity_sdk_2024.6.1/platform/radio/rail_lib/chip/efr32/efr32xg2x" -I"/home/novello/SimplicityStudio/v5_workspace/rail_soc_simple_trx_auto_ack/simplicity_sdk_2024.6.1/platform/radio/rail_lib/protocol/sidewalk" -I"/home/novello/SimplicityStudio/v5_workspace/rail_soc_simple_trx_auto_ack/simplicity_sdk_2024.6.1/platform/radio/rail_lib/plugin/rail_util_callbacks" -I"/home/novello/SimplicityStudio/v5_workspace/rail_soc_simple_trx_auto_ack/simplicity_sdk_2024.6.1/platform/radio/rail_lib/plugin/pa-conversions" -I"/home/novello/SimplicityStudio/v5_workspace/rail_soc_simple_trx_auto_ack/simplicity_sdk_2024.6.1/platform/radio/rail_lib/plugin/pa-conversions/efr32xg23" -I"/home/novello/SimplicityStudio/v5_workspace/rail_soc_simple_trx_auto_ack/simplicity_sdk_2024.6.1/platform/radio/rail_lib/plugin/rail_util_protocol" -I"/home/novello/SimplicityStudio/v5_workspace/rail_soc_simple_trx_auto_ack/simplicity_sdk_2024.6.1/platform/radio/rail_lib/plugin/rail_util_pti" -I"/home/novello/SimplicityStudio/v5_workspace/rail_soc_simple_trx_auto_ack/simplicity_sdk_2024.6.1/platform/radio/rail_lib/plugin/rail_util_rssi" -I"/home/novello/SimplicityStudio/v5_workspace/rail_soc_simple_trx_auto_ack/simplicity_sdk_2024.6.1/app/flex/component/rail/simple_rail_assistance" -I"/home/novello/SimplicityStudio/v5_workspace/rail_soc_simple_trx_auto_ack/simplicity_sdk_2024.6.1/app/flex/component/rail/sl_flex_rail_channel_selector" -I"/home/novello/SimplicityStudio/v5_workspace/rail_soc_simple_trx_auto_ack/simplicity_sdk_2024.6.1/app/flex/component/rail/sl_flex_rail_package_assistant" -I"/home/novello/SimplicityStudio/v5_workspace/rail_soc_simple_trx_auto_ack/simplicity_sdk_2024.6.1/app/flex/component/rail/sl_flex_rail_packet_asm" -I"/home/novello/SimplicityStudio/v5_workspace/rail_soc_simple_trx_auto_ack/simplicity_sdk_2024.6.1/platform/common/toolchain/inc" -I"/home/novello/SimplicityStudio/v5_workspace/rail_soc_simple_trx_auto_ack/simplicity_sdk_2024.6.1/platform/service/system/inc" -I"/home/novello/SimplicityStudio/v5_workspace/rail_soc_simple_trx_auto_ack/simplicity_sdk_2024.6.1/platform/service/udelay/inc" -Og -Wall -Wextra -ffunction-sections -fdata-sections -imacrossl_gcc_preinclude.h -mfpu=fpv5-sp-d16 -mfloat-abi=hard -mcmse -fno-builtin-printf -fno-builtin-sprintf --specs=nano.specs -c -fmessage-length=0 -MMD -MP -MF"
#Building file: ../autogen/sli_cli_hooks.c
#Invoking: GNU ARM C Compiler
#
#
target_compile_definitions(app PUBLIC SL_COMPONENT_CATALOG_PRESENT)
target_compile_definitions(app PUBLIC DSL_BOARD_NAME="BRD4210A")
```

## prj.conf
```kconfig
# Copyright (c) 2024 Silicon Laboratories Inc.
# SPDX-License-Identifier: Zlib
CONFIG_GPIO=y
CONFIG_SOC_GECKO_CUSTOM_RADIO_PHY=y
#CONFIG_SOC_GECKO_SE=y
CONFIG_FPU=y
#######CONFIG_PM=y
CONFIG_PRINTK=y
# STEP 2 - Enable the serial driver in asynchronous mode
CONFIG_SERIAL=y
CONFIG_UART_ASYNC_API=y
#CONFIG_HEAP_MEM_POOL_SIZE=4096


#fsk parameter
#CONFIG_LOG=y
CONFIG_SHELL=y
CONFIG_EVENTS=y
#CONFIG_ASSERT=y
#CONFIG_BOOT_BANNER=y
CONFIG_POSIX_CLOCK=y
CONFIG_INIT_STACKS=y
CONFIG_SMF=y
###################
CONFIG_DEBUG_OPTIMIZATIONS=y
CONFIG_EXCEPTION_STACK_TRACE=y
CONFIG_DEBUG_INFO=y
#CONFIG_ASSERT=y
# -- system debug options
CONFIG_SYS_HEAP_VALIDATE=y
CONFIG_STACK_SENTINEL=y
CONFIG_JSON_LIBRARY=y
```

## src/main.c
```c
/***************************************************************************//**
 * @file
 * @brief main.c
 *******************************************************************************
 * # License
 * <b>Copyright 2018 Silicon Laboratories Inc. www.silabs.com</b>
 *******************************************************************************
 *
 * SPDX-License-Identifier: Zlib
 *
 * The licensor of this software is Silicon Laboratories Inc.
 *
 * This software is provided 'as-is', without any express or implied
 * warranty. In no event will the authors be held liable for any damages
 * arising from the use of this software.
 *
 * Permission is granted to anyone to use this software for any purpose,
 * including commercial applications, and to alter it and redistribute it
 * freely, subject to the following restrictions:
 *
 * 1. The origin of this software must not be misrepresented; you must not
 *    claim that you wrote the original software. If you use this software
 *    in a product, an acknowledgment in the product documentation would be
 *    appreciated but is not required.
 * 2. Altered source versions must be plainly marked as such, and must not be
 *    misrepresented as being the original software.
 * 3. This notice may not be removed or altered from any source distribution.
 *
 ******************************************************************************/

// -----------------------------------------------------------------------------
//                                   Includes
// -----------------------------------------------------------------------------
#include <zephyr/kernel.h>
#include <zephyr/device.h>
#include <zephyr/drivers/gpio.h>
#include <zephyr/sys/util.h>
#include <zephyr/sys/printk.h>
#include <inttypes.h>
#include <zephyr/shell/shell.h>
#include <zephyr/logging/log.h>
#include "rail.h"
#include "rail_types.h"
#include "pa_conversions_efr32.h"
#include "sl_rail_util_init.h"
#include "sl_component_catalog.h"
#include "sl_system_init.h"
#if defined(SL_CATALOG_POWER_MANAGER_PRESENT)
  #include "sl_power_manager.h"
#endif
#include "app_init.h"
#include "app_process.h"
#if defined(SL_CATALOG_KERNEL_PRESENT)
  #include "sl_system_kernel.h"
  #include "app_task_init.h"
#else // SL_CATALOG_KERNEL_PRESENT
  #include "sl_system_process_action.h"
#endif // SL_CATALOG_KERNEL_PRESENT
#include "sl_event_handler.h"

void sl_system_process_action(void)
{
  sl_platform_process_action(); // vuoto
  sl_service_process_action();  ///  sl_cli_instances_tick();
  sl_stack_process_action(); // vuoto
  sl_internal_app_process_action(); /// vuoto
}


// -----------------------------------------------------------------------------
//                              Macros and Typedefs
// -----------------------------------------------------------------------------

// -----------------------------------------------------------------------------
//                          Static Function Declarations
// -----------------------------------------------------------------------------

// -----------------------------------------------------------------------------
//                                Global Variables
// -----------------------------------------------------------------------------

// -----------------------------------------------------------------------------
//                                Static Variables
// -----------------------------------------------------------------------------
#if !defined(SL_CATALOG_KERNEL_PRESENT)
/// A static handle of a RAIL instance
static RAIL_Handle_t rail_handle;
#endif
// -----------------------------------------------------------------------------
//                          Public Function Definitions
// -----------------------------------------------------------------------------
/******************************************************************************
 * Main function
 *****************************************************************************/
int main(void)
{
  // Initialize Silicon Labs device, system, service(s) and protocol stack(s).
  // Note that if the kernel is present, processing task(s) will be created by
  // this call.
  ///sl_system_init();
  app_init_gpios();
  sl_service_init();
  sl_stack_init();
  sl_internal_app_init();
  //sl_service_init();

  // Initialize the application. For example, create periodic timer(s) or
  // task(s) if the kernel is present.
#if defined(SL_CATALOG_KERNEL_PRESENT)
  app_task_init();
#else
  rail_handle = app_init();
#endif

#if defined(SL_CATALOG_KERNEL_PRESENT)
  // Start the kernel. Task(s) created in app_init() will start running.
  sl_system_kernel_start();
#else // SL_CATALOG_KERNEL_PRESENT
  while (1) {
    // Do not remove this call: Silicon Labs components process action routine
    // must be called from the super loop.
    sl_system_process_action();

    // Application process.
    app_process_action(rail_handle);

#if defined(SL_CATALOG_POWER_MANAGER_PRESENT)
    // Let the CPU go to sleep if the system allows it.
    sl_power_manager_sleep();
#endif
  }
#endif // SL_CATALOG_KERNEL_PRESENT
}

// -----------------------------------------------------------------------------
//                          Static Function Definitions
// -----------------------------------------------------------------------------
```

## src/app_gpio.c
```c
/***************************************************************************//**
 * @file app_gpio.c
 * @brief GPIO handling for the proprietary_trx example.
 *******************************************************************************
 * # License
 * <b>Copyright 2024 Silicon Laboratories Inc. www.silabs.com</b>
 *******************************************************************************
 *
 * SPDX-License-Identifier: Zlib
 *
 * The licensor of this software is Silicon Laboratories Inc.
 *
 * This software is provided 'as-is', without any express or implied
 * warranty. In no event will the authors be held liable for any damages
 * arising from the use of this software.
 *
 * Permission is granted to anyone to use this software for any purpose,
 * including commercial applications, and to alter it and redistribute it
 * freely, subject to the following restrictions:
 *
 * 1. The origin of this software must not be misrepresented; you must not
 *    claim that you wrote the original software. If you use this software
 *    in a product, an acknowledgment in the product documentation would be
 *    appreciated but is not required.
 * 2. Altered source versions must be plainly marked as such, and must not be
 *    misrepresented as being the original software.
 * 3. This notice may not be removed or altered from any source distribution.
 *
 ******************************************************************************/

// -----------------------------------------------------------------------------
// Includes

#include <zephyr/kernel.h>
#include <zephyr/device.h>
#include <zephyr/drivers/gpio.h>
#include <zephyr/sys/util.h>
#include <zephyr/sys/printk.h>
#include <inttypes.h>
#include <zephyr/shell/shell.h>
#include <zephyr/logging/log.h>
#include "errno.h"
#include "app_gpio.h"

// -----------------------------------------------------------------------------
// Macros and Typedefs

LOG_MODULE_DECLARE(trx_app_log);

// -----------------------------------------------------------------------------
// Static Function Declarations

// Callback function to handle button press for sending a packet
static void button_pressed(const struct device *dev, struct gpio_callback *cb, uint32_t pins);

// Initialize given button to use button_press callback
static int init_button(const struct gpio_dt_spec *button);

static int init_led(const struct gpio_dt_spec *led);

// -----------------------------------------------------------------------------
// Global Variables

// -----------------------------------------------------------------------------
// Static Variables

// -----------------------------------------------------------------------------
// Public Function Definitions

int app_init_gpios(struct s_prop_var *s_state)
{
	BUILD_ASSERT(DT_NODE_HAS_STATUS(DT_ALIAS(sw0), okay),
		     "Unsupported board: sw0 devicetree alias is not defined");
	BUILD_ASSERT(DT_NODE_HAS_STATUS(DT_ALIAS(led0), okay),
		     "Unsupported board: led0 devicetree alias is not defined");

	int ret = 0;
	ret = init_button(&s_state->button0);
	if (ret) {
		return ret;
	}
	if (DT_NODE_HAS_STATUS(DT_ALIAS(sw1), okay)) {
		ret = init_button(&s_state->button1);
		if (ret) {
			return ret;
		}
	}

	ret = init_led(&s_state->led0);
	if (ret) {
		return ret;
	}

	if (DT_NODE_HAS_STATUS(DT_ALIAS(led1), okay)) {
		ret = init_led(&s_state->led1);
		if (ret) {
			return ret;
		}
	}
 if (DT_NODE_HAS_STATUS(DT_ALIAS(led1), okay)) {
	///	gpio_pin_set_dt(&led, val);
		ret = gpio_pin_set_dt(&s_state->led1,1);
		if (ret) {
			LOG_WRN("Led toggle for led1 returned with %d", ret);
		}
	} else {
		ret = gpio_pin_toggle_dt(&s_state->led0);
		if (ret) {
			LOG_WRN("Led toggle for led0 returned with %d", ret);
		}
	}
	return ret;
}

void app_update_receive_led(struct s_prop_var *s_state)
{
	int ret = 0;
	ret = gpio_pin_toggle_dt(&(s_state->led0));
	if (ret) {
		LOG_WRN("Led toggle for led0 returned with %d", ret);
	}
}

void app_update_send_led(struct s_prop_var *s_state)
{
	int ret = 0;
	if (DT_NODE_HAS_STATUS(DT_ALIAS(led1), okay)) {
	///	gpio_pin_set_dt(&led, val);
		ret = gpio_pin_set_dt(&s_state->led1,1);
		if (ret) {
			LOG_WRN("Led toggle for led1 returned with %d", ret);
		}
	} else {
		ret = gpio_pin_toggle_dt(&s_state->led0);
		if (ret) {
			LOG_WRN("Led toggle for led0 returned with %d", ret);
		}
	}
}
// -----------------------------------------------------------------------------
// Static Function Definitions

static void button_pressed(const struct device *dev, struct gpio_callback *cb, uint32_t pins)
{
	struct s_prop_var *context = CONTAINER_OF(cb, struct s_prop_var, button_cb_data);
	k_event_post(&context->smf_event, EVENT_REQUEST_SEND);
}

static int init_button(const struct gpio_dt_spec *button)
{
	int ret = 0;
	if (!gpio_is_ready_dt(button)) {
		LOG_ERR("Error: button device %s is not ready", button->port->name);
		return -EINVAL;
	}

	ret = gpio_pin_configure_dt(button, GPIO_INPUT);
	if (ret) {
		LOG_ERR("Error %d: failed to configure %s pin %d", ret, button->port->name,
			button->pin);
		return ret;
	}

	ret = gpio_pin_interrupt_configure_dt(button, GPIO_INT_EDGE_TO_ACTIVE);
	if (ret) {
		LOG_ERR("Error %d: failed to configure interrupt on %s pin %d", ret,
			button->port->name, button->pin);
		return ret;
	}

	gpio_init_callback(&s_sl_machine.button_cb_data, button_pressed, BIT(button->pin));
	gpio_add_callback(button->port, &s_sl_machine.button_cb_data);

	return 0;
}

static int init_led(const struct gpio_dt_spec *led)
{
	int ret = 0;
	if (led->port && !gpio_is_ready_dt(led)) {
		LOG_ERR("LED device %s is not ready; ignoring it", led->port->name);
		return -EINVAL;
	}

	ret = gpio_pin_configure_dt(led, GPIO_OUTPUT);
	if (ret) {
		LOG_ERR("Error %d: failed to configure LED device %s pin %d", ret, led->port->name,
			led->pin);
		return ret;
	}

	ret = gpio_pin_set_dt(led, 0);
	if (ret) {
		LOG_WRN("Led clear for %s returned with %d", led->port->name, ret);
	}

	return 0;
}
```

## src/app_init.c
```c
/***************************************************************************//**
 * @file
 * @brief app_init.c
 *******************************************************************************
 * # License
 * <b>Copyright 2018 Silicon Laboratories Inc. www.silabs.com</b>
 *******************************************************************************
 *
 * SPDX-License-Identifier: Zlib
 *
 * The licensor of this software is Silicon Laboratories Inc.
 *
 * This software is provided 'as-is', without any express or implied
 * warranty. In no event will the authors be held liable for any damages
 * arising from the use of this software.
 *
 * Permission is granted to anyone to use this software for any purpose,
 * including commercial applications, and to alter it and redistribute it
 * freely, subject to the following restrictions:
 *
 * 1. The origin of this software must not be misrepresented; you must not
 *    claim that you wrote the original software. If you use this software
 *    in a product, an acknowledgment in the product documentation would be
 *    appreciated but is not required.
 * 2. Altered source versions must be plainly marked as such, and must not be
 *    misrepresented as being the original software.
 * 3. This notice may not be removed or altered from any source distribution.
 *
 ******************************************************************************/

// -----------------------------------------------------------------------------
//                                   Includes
// -----------------------------------------------------------------------------
#include <stdint.h>
#include "sl_component_catalog.h"
#include "simple_rail_assistance.h"
#include "rail.h"
#include "sl_rail_util_init.h"
#include "app_process.h"
#include "sl_flex_rail_channel_selector.h"

#if defined(SL_CATALOG_KERNEL_PRESENT)
#include "app_task_init.h"
#endif

// -----------------------------------------------------------------------------
//                              Macros and Typedefs
// -----------------------------------------------------------------------------

// -----------------------------------------------------------------------------
//                          Static Function Declarations
// -----------------------------------------------------------------------------

// -----------------------------------------------------------------------------
//                                Global Variables
// -----------------------------------------------------------------------------

// -----------------------------------------------------------------------------
//                                Static Variables
// -----------------------------------------------------------------------------

// -----------------------------------------------------------------------------
//                          Public Function Definitions
// -----------------------------------------------------------------------------
/******************************************************************************
 * Print sample app name
 *****************************************************************************/
SL_WEAK void print_sample_app_name(const char* app_name)
{
  app_log_info("%s\n", app_name);
}

/******************************************************************************
 * The function is used for some basic initialization related to the app.
 *****************************************************************************/
RAIL_Handle_t app_init(void)
{
  // Get RAIL handle, used later by the application
  RAIL_Handle_t rail_handle = sl_rail_util_get_handle(SL_RAIL_UTIL_HANDLE_INST0);

  set_up_tx_fifo(rail_handle);

  // Turn OFF LEDs
  //clear_receive_led();
  //clear_send_led();
  // Start reception
  RAIL_Status_t status = RAIL_StartRx(rail_handle, get_selected_channel(), NULL);
  RAIL_ConfigRxOptions(rail_handle, RAIL_RX_OPTIONS_ALL, RAIL_RX_OPTION_IGNORE_CRC_ERRORS);
  if (status != RAIL_STATUS_NO_ERROR) 
  {
    app_log_warning("After initialization RAIL_StartRx() result:%d ", status);
  }

  // CLI info message
  print_sample_app_name("Simple TRX");

  return rail_handle;
}

// -----------------------------------------------------------------------------
//                          Static Function Definitions
// -----------------------------------------------------------------------------
```

## src/app_process.c
```c
/***************************************************************************//**
 * @file
 * @brief app_tick.c
 *******************************************************************************
 * # License
 * <b>Copyright 2018 Silicon Laboratories Inc. www.silabs.com</b>
 *******************************************************************************
 *
 * SPDX-License-Identifier: Zlib
 *
 * The licensor of this software is Silicon Laboratories Inc.
 *
 * This software is provided 'as-is', without any express or implied
 * warranty. In no event will the authors be held liable for any damages
 * arising from the use of this software.
 *
 * Permission is granted to anyone to use this software for any purpose,
 * including commercial applications, and to alter it and redistribute it
 * freely, subject to the following restrictions:
 *
 * 1. The origin of this software must not be misrepresented; you must not
 *    claim that you wrote the original software. If you use this software
 *    in a product, an acknowledgment in the product documentation would be
 *    appreciated but is not required.
 * 2. Altered source versions must be plainly marked as such, and must not be
 *    misrepresented as being the original software.
 * 3. This notice may not be removed or altered from any source distribution.
 *
 ******************************************************************************/

// -----------------------------------------------------------------------------
//                                   Includes
// -----------------------------------------------------------------------------
#include <stdint.h>
#include "sl_component_catalog.h"
#include "simple_rail_assistance.h"
#include "rail.h"
#include "app_process.h"
//#include "sl_simple_button_instances.h"
#include "sl_flex_rail_package_assistant.h"
#include "sl_flex_rail_config.h"
#include "sl_flex_rail_channel_selector.h"

#if defined(SL_CATALOG_KERNEL_PRESENT)
#include "app_task_init.h"
#endif

#include "rail_types.h"
#include "cmsis_compiler.h"

#if defined(SL_CATALOG_RAIL_SIMPLE_CPC_PRESENT)
#include "sl_rail_simple_cpc.h"
#endif

// -----------------------------------------------------------------------------
//                              Macros and Typedefs
// -----------------------------------------------------------------------------
/// Transmit data length
#define TX_PAYLOAD_LENGTH (16U)

/// State machine of simple_trx
typedef enum {
  S_PACKET_RECEIVED,
  S_PACKET_SENT,
  S_RX_PACKET_ERROR,
  S_TX_PACKET_ERROR,
  S_CALIBRATION_ERROR,
  S_IDLE,
} state_t;

// -----------------------------------------------------------------------------
//                          Static Function Declarations
// -----------------------------------------------------------------------------

// -----------------------------------------------------------------------------
//                                Global Variables
// -----------------------------------------------------------------------------
/// Flag, indicating transmit request (button was pressed / CLI transmit request has occurred)
volatile bool tx_requested = false;
/// Flag, indicating received packet is forwarded on CLI or not
volatile bool rx_requested = true;

// -----------------------------------------------------------------------------
//                                Static Variables
// -----------------------------------------------------------------------------
/// The variable shows the actual state of the state machine
static volatile state_t state = S_IDLE;

/// Contains the last RAIL Rx/Tx error events
static volatile uint64_t error_code = 0;

/// Contains the status of RAIL Calibration
static volatile RAIL_Status_t calibration_status = 0;

/// Receive and Send FIFO
static __ALIGNED(RAIL_FIFO_ALIGNMENT) uint8_t rx_fifo[SL_FLEX_RAIL_RX_FIFO_SIZE];

static __ALIGNED(RAIL_FIFO_ALIGNMENT) uint8_t tx_fifo[SL_FLEX_RAIL_TX_FIFO_SIZE];

/// Transmit packet
static uint8_t out_packet[TX_PAYLOAD_LENGTH] = {
  0x0F, 0x16, 0x11, 0x22, 0x33, 0x44, 0x55, 0x66,
  0x77, 0x88, 0x99, 0xAA, 0xBB, 0xCC, 0xDD, 0xEE,
};

/// Flags to update state machine from interrupt
static volatile bool packet_recieved = false;
static volatile bool packet_sent = false;
static volatile bool rx_error = false;
static volatile bool tx_error = false;
static volatile bool cal_error = false;

// -----------------------------------------------------------------------------
//                          Public Function Definitions
// -----------------------------------------------------------------------------
/******************************************************************************
 * Application state machine, called infinitely
 *****************************************************************************/
void app_process_action(RAIL_Handle_t rail_handle)
{
  // RAIL Rx packet handles
  RAIL_RxPacketHandle_t rx_packet_handle;
  RAIL_RxPacketInfo_t packet_info;
  // Status indicator of the RAIL API calls
  RAIL_Status_t rail_status = RAIL_STATUS_NO_ERROR;
  RAIL_Status_t calibration_status_buff = RAIL_STATUS_NO_ERROR;
  #if defined(SL_CATALOG_RAIL_SIMPLE_CPC_PRESENT)
  uint8_t success_sent = 0x01;
  #endif

  if (packet_recieved) {
    packet_recieved = false;
    state = S_PACKET_RECEIVED;
  } else if (packet_sent) {
    packet_sent = false;
    state = S_PACKET_SENT;
  } else if (rx_error) {
    rx_error = false;
    state = S_RX_PACKET_ERROR;
  } else if (tx_error) {
    tx_error = false;
    state = S_TX_PACKET_ERROR;
  } else if (cal_error) {
    cal_error = false;
    state = S_CALIBRATION_ERROR;
  }

  switch (state) {
    case S_PACKET_RECEIVED:
      // Packet received:
      //  - Check whether RAIL_HoldRxPacket() was successful, i.e. packet handle is valid
      //  - Copy it to the application FIFO
      //  - Free up the radio FIFO
      //  - Return to app IDLE state (RAIL will automatically switch back to Rx radio state)
      rx_packet_handle = RAIL_GetRxPacketInfo(rail_handle, RAIL_RX_PACKET_HANDLE_OLDEST_COMPLETE, &packet_info);
      while (rx_packet_handle != RAIL_RX_PACKET_HANDLE_INVALID) {
        uint8_t *start_of_packet = 0;
        uint16_t packet_size = unpack_packet(rx_fifo, &packet_info, &start_of_packet);
        rail_status = RAIL_ReleaseRxPacket(rail_handle, rx_packet_handle);
        if (rail_status != RAIL_STATUS_NO_ERROR) {
          app_log_warning("RAIL_ReleaseRxPacket() result:%d", rail_status);
        }
        if (rx_requested) {
          printf_rx_packet(start_of_packet, packet_size);
#if defined(SL_CATALOG_RAIL_SIMPLE_CPC_PRESENT)
          sl_rail_simple_cpc_transmit(packet_size, start_of_packet);
#endif
        }
        toggle_receive_led();
        rx_packet_handle = RAIL_GetRxPacketInfo(rail_handle, RAIL_RX_PACKET_HANDLE_OLDEST_COMPLETE, &packet_info);
      }
      state = S_IDLE;
      break;
    case S_PACKET_SENT:
      app_log_info("Packet has been sent\n");
#if defined(SL_CATALOG_RAIL_SIMPLE_CPC_PRESENT)
      sl_rail_simple_cpc_transmit(1, &success_sent);
#endif

      toggle_send_led();
      state = S_IDLE;
      break;
    case S_RX_PACKET_ERROR:
      // Handle Rx error
      app_log_error("Radio RX Error occurred\nEvents: %llX\n", error_code);
      state = S_IDLE;
      break;
    case S_TX_PACKET_ERROR:
      // Handle Tx error
      app_log_error("Radio TX Error occurred\nEvents: %llX\n", error_code);
      state = S_IDLE;
      break;
    case S_IDLE:
      if (tx_requested) {
        prepare_package(rail_handle, out_packet, sizeof(out_packet));
        rail_status = RAIL_StartTx(rail_handle, get_selected_channel(), RAIL_TX_OPTIONS_DEFAULT, NULL);
        if (rail_status != RAIL_STATUS_NO_ERROR) {
          app_log_warning("RAIL_StartTx() result:%d ", rail_status);
        }
        tx_requested = false;
      }
      break;
    case S_CALIBRATION_ERROR:
      calibration_status_buff = calibration_status;
      app_log_error("Radio Calibration Error occurred\nEvents: %llX\nRAIL_Calibrate() result:%d\n",
                    error_code,
                    calibration_status_buff);
      state = S_IDLE;
      break;
    default:
      // Unexpected state
      app_log_error("Unexpected Simple TRX state occurred:%d\n", state);
      break;
  }
}

/******************************************************************************
 * RAIL callback, called if a RAIL event occurs.
 *****************************************************************************/
void sl_rail_util_on_event(RAIL_Handle_t rail_handle, RAIL_Events_t events)
{
  error_code = events;
  // Handle Rx events
  if ( events & RAIL_EVENTS_RX_COMPLETION ) {
    if (events & RAIL_EVENT_RX_PACKET_RECEIVED) {
      // Keep the packet in the radio buffer, download it later at the state machine
      RAIL_HoldRxPacket(rail_handle);
      packet_recieved = true;
    } else {
      // Handle Rx error
      rx_error = true;
    }
  }
  // Handle Tx events
  if ( events & RAIL_EVENTS_TX_COMPLETION) {
    if (events & RAIL_EVENT_TX_PACKET_SENT) {
      packet_sent = true;
    } else {
      // Handle Tx error
      tx_error = true;
    }
  }

  // Perform all calibrations when needed
  if ( events & RAIL_EVENT_CAL_NEEDED ) {
    calibration_status = RAIL_Calibrate(rail_handle, NULL, RAIL_CAL_ALL_PENDING);
    if (calibration_status != RAIL_STATUS_NO_ERROR) {
      cal_error = true;
    }
  }
#if defined(SL_CATALOG_KERNEL_PRESENT)
  app_task_notify();
#endif
}

/******************************************************************************
 * Button callback, called if any button is pressed or released.
 *****************************************************************************/

#if defined(SL_CATALOG_RAIL_SIMPLE_CPC_PRESENT)
void sl_rail_simple_cpc_receive_cb(sl_status_t status, uint32_t len, uint8_t *data)
{
  //SL_STATUS_OK
  if (status == SL_STATUS_OK) {
    if (len == 1) {
      if (data[0] == 0x01 || data[0] == '1') {
        tx_requested = true;
      }
      if (data[0] == 0x00 || data[0] == '0') {
        rx_requested = !rx_requested;
      }
    }
  }
}
#endif

/******************************************************************************
 * Set up the rail TX fifo for later usage
 * @param rail_handle Which rail handler should be updated
 *****************************************************************************/
void set_up_tx_fifo(RAIL_Handle_t rail_handle)
{
  uint16_t allocated_tx_fifo_size = 0;
 allocated_tx_fifo_size = RAIL_SetTxFifo(rail_handle, tx_fifo, 0, SL_FLEX_RAIL_TX_FIFO_SIZE);
#ifdef NOVELLO  
  app_assert(allocated_tx_fifo_size == SL_FLEX_RAIL_TX_FIFO_SIZE,
             "RAIL_SetTxFifo() failed to allocate a large enough fifo (%d bytes instead of %d bytes)\n",
             allocated_tx_fifo_size,
             SL_FLEX_RAIL_TX_FIFO_SIZE);
#endif
}
#define RAC_SEQ_IRQn  38
#define SYNTH_IRQn 40
///#define RAC_RSM_IRQn 27
#define PROTIMER_IRQn 36
#define MODEM_IRQn 35
#define FRC_IRQn 34
#define BUFC_IRQn 32
#define AGC_IRQn 31
void rail_isr_installer(void)
{
//#ifdef CONFIG_SOC_SERIES_EFR32MG24
	IRQ_CONNECT(SYNTH_IRQn, 0, SYNTH_IRQHandler, NULL, 0);
//#else
//	IRQ_CONNECT(RDMAILBOX_IRQn, 0, RDMAILBOX_IRQHandler, NULL, 0);
//#endif
	IRQ_CONNECT(RAC_SEQ_IRQn, 0, RAC_SEQ_IRQHandler, NULL, 0);
	IRQ_CONNECT(RAC_RSM_IRQn, 0, RAC_RSM_IRQHandler, NULL, 0);
	IRQ_CONNECT(PROTIMER_IRQn, 0, PROTIMER_IRQHandler, NULL, 0);
	IRQ_CONNECT(MODEM_IRQn, 0, MODEM_IRQHandler, NULL, 0);
	IRQ_CONNECT(FRC_IRQn, 0, FRC_IRQHandler, NULL, 0);
	IRQ_CONNECT(BUFC_IRQn, 0, BUFC_IRQHandler, NULL, 0);
	IRQ_CONNECT(AGC_IRQn, 0, AGC_IRQHandler, NULL, 0);
}


// -----------------------------------------------------------------------------
//                          Static Function Definitions
// -----------------------------------------------------------------------------
```
