## boards/arm/dk6_qn9090/Kconfig.board
```kconfig
#
# Copyright (c) 2023 Sendrato
#
# SPDX-License-Identifier: Apache-2.0
#

config BOARD_DK6_QN9090
	bool "NXP QN9090DK6"
	depends on SOC_SERIES_K32
	select SOC_PART_NUMBER_K32_QN9090THN
```

## boards/arm/dk6_qn9090/Kconfig.defconfig
```kconfig
#
# Copyright (c) 2023 Sendrato
#
# SPDX-License-Identifier: Apache-2.0
#

config BOARD
	default "dk6_qn9090" if BOARD_DK6_QN9090
```

## boards/silabs/autecradio/Kconfig
```kconfig
# EFR32XG24 DK2601B board

# Copyright (c) 2022, Silicon Labs
# SPDX-License-Identifier: Apache-2.0

if BOARD_AUTECRADIO

module = BOARD_EFR32ZG23
module-str = Board Control
source "subsys/logging/Kconfig.template.log_config"

endif # BOARD_AUTECRADIO
```

## boards/silabs/autecradio/Kconfig.autecradio
```kconfig
# EFR32XG24 DK2601B board

# Copyright (c) 2021, Sateesh Kotapati
# SPDX-License-Identifier: Apache-2.0

config BOARD_AUTECRADIO
	select SOC_PART_NUMBER_EFR32ZG23B020F512IM48
```

## boards/silabs/autecradio/board.yml
```yaml
board:
  name: autecradio
  vendor: silabs
  socs:
  - name: efr32zg23b020f512im48
```

## boards/silabs/fg23/Kconfig
```kconfig
# EFR32XG24 DK2601B board

# Copyright (c) 2022, Silicon Labs
# SPDX-License-Identifier: Apache-2.0

if BOARD_FG23

module = BOARD_FG23
module-str = Board Control
source "subsys/logging/Kconfig.template.log_config"

endif # BOARD_FG23
```

## boards/silabs/fg23/Kconfig.fg23
```kconfig
# EFR32XG24 DK2601B board

# Copyright (c) 2021, Sateesh Kotapati
# SPDX-License-Identifier: Apache-2.0

config BOARD_FG23
	select SOC_PART_NUMBER_EFR32FG23A010F512GM48
```

## boards/silabs/fg2x/Kconfig
```kconfig
# EFR32XG24 DK2601B board

# Copyright (c) 2022, Silicon Labs
# SPDX-License-Identifier: Apache-2.0

if BOARD_FG2X

module = BOARD_FG2X
module-str = Board Control
source "subsys/logging/Kconfig.template.log_config"

endif # BOARD_FG2X
```

## boards/silabs/fg2x/Kconfig.defconfig
```kconfig
# EFR32XG24 DK2601B board

# Copyright (c) 2021, Sateesh Kotapati
# SPDX-License-Identifier: Apache-2.0

if BOARD_FG2X

config CMU_HFXO_FREQ
	default 39000000

config CMU_LFXO_FREQ
	default 32768

config FLASH_BASE_ADDRESS
	hex
	default 0x08000000

#config LOG_BACKEND_SWO_FREQ_HZ
#	default 875000
#	depends on LOG_BACKEND_SWO

if SOC_GECKO_USE_RAIL

config FPU
	default y


config COMMON_LIBC_MALLOC_ARENA_SIZE
	default 8192

config MAIN_STACK_SIZE
#	default 3072 if PM
	default 2304

if SHELL

config SHELL_STACK_SIZE
	default 4096

endif # SHEL
endif # SOC_GECKO_USE_RAIL

if BT

config FPU
	default y

config COMMON_LIBC_MALLOC_ARENA_SIZE
	default 8192

config MAIN_STACK_SIZE
#	default 3072 if PM
	default 2304

if SHELL

config SHELL_STACK_SIZE
	default 4096

endif # SHELL

endif # BT

endif # BOARD_FG2X
```

## boards/silabs/fg2x/Kconfig.fg2x
```kconfig
# EFR32XG24 DK2601B board

# Copyright (c) 2021, Sateesh Kotapati
# SPDX-License-Identifier: Apache-2.0

config BOARD_FG2X
	select SOC_PART_NUMBER_EFR32FG28B312F1024IM68 
	#select SOC_PART_NUMBER_EFR32ZG28B322F1024IM48
	#select SOC_PART_NUMBER_EFR32MG24B220F1536IM48
```

## examples/trx/build/Kconfig/arch/Kconfig
```kconfig
# Load arch Kconfig descriptions.
osource "/home/novello/zephyr3.7B/R5x_No/zephyr/arch/x86/Kconfig"
osource "/home/novello/zephyr3.7B/R5x_No/zephyr/arch/xtensa/Kconfig"
osource "/home/novello/zephyr3.7B/R5x_No/zephyr/arch/sparc/Kconfig"
osource "/home/novello/zephyr3.7B/R5x_No/zephyr/arch/riscv/Kconfig"
osource "/home/novello/zephyr3.7B/R5x_No/zephyr/arch/posix/Kconfig"
osource "/home/novello/zephyr3.7B/R5x_No/zephyr/arch/nios2/Kconfig"
osource "/home/novello/zephyr3.7B/R5x_No/zephyr/arch/mips/Kconfig"
osource "/home/novello/zephyr3.7B/R5x_No/zephyr/arch/arm64/Kconfig"
osource "/home/novello/zephyr3.7B/R5x_No/zephyr/arch/arm/Kconfig"
osource "/home/novello/zephyr3.7B/R5x_No/zephyr/arch/arc/Kconfig"
```

## examples/trx1/build/Kconfig/Kconfig.shield
```kconfig
osource "/home/novello/zephyr3.7B/R5x_No/autec-dir/boards/shields/*/Kconfig.shield"
```

## examples/trx1/build/Kconfig/soc/Kconfig
```kconfig
# Load Zephyr SoC Kconfig descriptions.
osource "/home/novello/zephyr3.7B/R5x_No/zephyr/soc/xlnx/zynqmp/Kconfig"
osource "/home/novello/zephyr3.7B/R5x_No/zephyr/soc/xlnx/zynq7000/Kconfig"
osource "/home/novello/zephyr3.7B/R5x_No/zephyr/soc/xen/Kconfig"
osource "/home/novello/zephyr3.7B/R5x_No/zephyr/soc/ti/simplelink/Kconfig"
osource "/home/novello/zephyr3.7B/R5x_No/zephyr/soc/ti/lm3s6965/Kconfig"
osource "/home/novello/zephyr3.7B/R5x_No/zephyr/soc/ti/k3/Kconfig"
osource "/home/novello/zephyr3.7B/R5x_No/zephyr/soc/telink/tlsr/Kconfig"
osource "/home/novello/zephyr3.7B/R5x_No/zephyr/soc/starfive/jh71xx/Kconfig"
osource "/home/novello/zephyr3.7B/R5x_No/zephyr/soc/st/stm32/Kconfig"
osource "/home/novello/zephyr3.7B/R5x_No/zephyr/soc/snps/qemu_arc/Kconfig"
osource "/home/novello/zephyr3.7B/R5x_No/zephyr/soc/snps/nsim/arc_v/Kconfig"
osource "/home/novello/zephyr3.7B/R5x_No/zephyr/soc/snps/nsim/arc_classic/Kconfig"
osource "/home/novello/zephyr3.7B/R5x_No/zephyr/soc/snps/hsdk4xd/Kconfig"
osource "/home/novello/zephyr3.7B/R5x_No/zephyr/soc/snps/hsdk/Kconfig"
osource "/home/novello/zephyr3.7B/R5x_No/zephyr/soc/snps/emsk/Kconfig"
osource "/home/novello/zephyr3.7B/R5x_No/zephyr/soc/snps/emsdp/Kconfig"
osource "/home/novello/zephyr3.7B/R5x_No/zephyr/soc/snps/arc_iot/Kconfig"
osource "/home/novello/zephyr3.7B/R5x_No/zephyr/soc/silabs/Kconfig"
osource "/home/novello/zephyr3.7B/R5x_No/zephyr/soc/sifive/sifive_freedom/Kconfig"
osource "/home/novello/zephyr3.7B/R5x_No/zephyr/soc/rockchip/Kconfig"
osource "/home/novello/zephyr3.7B/R5x_No/zephyr/soc/renode/riscv_virtual/Kconfig"
osource "/home/novello/zephyr3.7B/R5x_No/zephyr/soc/renesas/smartbond/Kconfig"
osource "/home/novello/zephyr3.7B/R5x_No/zephyr/soc/renesas/rzt2m/Kconfig"
osource "/home/novello/zephyr3.7B/R5x_No/zephyr/soc/renesas/rcar/Kconfig"
osource "/home/novello/zephyr3.7B/R5x_No/zephyr/soc/renesas/ra/Kconfig"
osource "/home/novello/zephyr3.7B/R5x_No/zephyr/soc/raspberrypi/Kconfig"
osource "/home/novello/zephyr3.7B/R5x_No/zephyr/soc/quicklogic/eos_s3/Kconfig"
osource "/home/novello/zephyr3.7B/R5x_No/zephyr/soc/qemu/virt_riscv/Kconfig"
osource "/home/novello/zephyr3.7B/R5x_No/zephyr/soc/qemu/malta/Kconfig"
osource "/home/novello/zephyr3.7B/R5x_No/zephyr/soc/openisa/rv32m1/Kconfig"
osource "/home/novello/zephyr3.7B/R5x_No/zephyr/soc/nxp/s32/Kconfig"
osource "/home/novello/zephyr3.7B/R5x_No/zephyr/soc/nxp/rw/Kconfig"
osource "/home/novello/zephyr3.7B/R5x_No/zephyr/soc/nxp/mcx/Kconfig"
osource "/home/novello/zephyr3.7B/R5x_No/zephyr/soc/nxp/lpc/Kconfig"
osource "/home/novello/zephyr3.7B/R5x_No/zephyr/soc/nxp/layerscape/Kconfig"
osource "/home/novello/zephyr3.7B/R5x_No/zephyr/soc/nxp/kinetis/Kconfig"
osource "/home/novello/zephyr3.7B/R5x_No/zephyr/soc/nxp/imxrt/Kconfig"
osource "/home/novello/zephyr3.7B/R5x_No/zephyr/soc/nxp/imx/Kconfig"
osource "/home/novello/zephyr3.7B/R5x_No/zephyr/soc/nuvoton/numicro/Kconfig"
osource "/home/novello/zephyr3.7B/R5x_No/zephyr/soc/nuvoton/numaker/Kconfig"
osource "/home/novello/zephyr3.7B/R5x_No/zephyr/soc/nuvoton/npcx/Kconfig"
osource "/home/novello/zephyr3.7B/R5x_No/zephyr/soc/nordic/Kconfig"
osource "/home/novello/zephyr3.7B/R5x_No/zephyr/soc/neorv32/Kconfig"
osource "/home/novello/zephyr3.7B/R5x_No/zephyr/soc/native/inf_clock/Kconfig"
osource "/home/novello/zephyr3.7B/R5x_No/zephyr/soc/microchip/miv/Kconfig"
osource "/home/novello/zephyr3.7B/R5x_No/zephyr/soc/microchip/mec/Kconfig"
osource "/home/novello/zephyr3.7B/R5x_No/zephyr/soc/mediatek/mtk_adsp/Kconfig"
osource "/home/novello/zephyr3.7B/R5x_No/zephyr/soc/lowrisc/opentitan/Kconfig"
osource "/home/novello/zephyr3.7B/R5x_No/zephyr/soc/litex/litex_vexriscv/Kconfig"
osource "/home/novello/zephyr3.7B/R5x_No/zephyr/soc/ite/ec/Kconfig"
osource "/home/novello/zephyr3.7B/R5x_No/zephyr/soc/intel/raptor_lake/Kconfig"
osource "/home/novello/zephyr3.7B/R5x_No/zephyr/soc/intel/lakemont/Kconfig"
osource "/home/novello/zephyr3.7B/R5x_No/zephyr/soc/intel/intel_socfpga_std/Kconfig"
osource "/home/novello/zephyr3.7B/R5x_No/zephyr/soc/intel/intel_socfpga/Kconfig"
osource "/home/novello/zephyr3.7B/R5x_No/zephyr/soc/intel/intel_niosv/Kconfig"
osource "/home/novello/zephyr3.7B/R5x_No/zephyr/soc/intel/intel_ish/Kconfig"
osource "/home/novello/zephyr3.7B/R5x_No/zephyr/soc/intel/intel_adsp/Kconfig"
osource "/home/novello/zephyr3.7B/R5x_No/zephyr/soc/intel/elkhart_lake/Kconfig"
osource "/home/novello/zephyr3.7B/R5x_No/zephyr/soc/intel/atom/Kconfig"
osource "/home/novello/zephyr3.7B/R5x_No/zephyr/soc/intel/apollo_lake/Kconfig"
osource "/home/novello/zephyr3.7B/R5x_No/zephyr/soc/intel/alder_lake/Kconfig"
osource "/home/novello/zephyr3.7B/R5x_No/zephyr/soc/infineon/cat3/Kconfig"
osource "/home/novello/zephyr3.7B/R5x_No/zephyr/soc/infineon/cat1b/Kconfig"
osource "/home/novello/zephyr3.7B/R5x_No/zephyr/soc/infineon/cat1a/Kconfig"
osource "/home/novello/zephyr3.7B/R5x_No/zephyr/soc/gd/gd32/Kconfig"
osource "/home/novello/zephyr3.7B/R5x_No/zephyr/soc/gaisler/leon3/Kconfig"
osource "/home/novello/zephyr3.7B/R5x_No/zephyr/soc/gaisler/gr716a/Kconfig"
osource "/home/novello/zephyr3.7B/R5x_No/zephyr/soc/espressif/Kconfig"
osource "/home/novello/zephyr3.7B/R5x_No/zephyr/soc/ene/kb1200/Kconfig"
osource "/home/novello/zephyr3.7B/R5x_No/zephyr/soc/efinix/sapphire/Kconfig"
osource "/home/novello/zephyr3.7B/R5x_No/zephyr/soc/cdns/xtensa_sample_controller/Kconfig"
osource "/home/novello/zephyr3.7B/R5x_No/zephyr/soc/cdns/dc233c/Kconfig"
osource "/home/novello/zephyr3.7B/R5x_No/zephyr/soc/brcm/bcmvk/Kconfig"
osource "/home/novello/zephyr3.7B/R5x_No/zephyr/soc/brcm/bcm2712/Kconfig"
osource "/home/novello/zephyr3.7B/R5x_No/zephyr/soc/brcm/bcm2711/Kconfig"
osource "/home/novello/zephyr3.7B/R5x_No/zephyr/soc/atmel/sam0/Kconfig"
osource "/home/novello/zephyr3.7B/R5x_No/zephyr/soc/atmel/sam/Kconfig"
osource "/home/novello/zephyr3.7B/R5x_No/zephyr/soc/aspeed/Kconfig"
osource "/home/novello/zephyr3.7B/R5x_No/zephyr/soc/arm/Kconfig"
osource "/home/novello/zephyr3.7B/R5x_No/zephyr/soc/arm/beetle/Kconfig"
osource "/home/novello/zephyr3.7B/R5x_No/zephyr/soc/andestech/Kconfig"
osource "/home/novello/zephyr3.7B/R5x_No/zephyr/soc/ambiq/Kconfig"
osource "/home/novello/zephyr3.7B/R5x_No/zephyr/soc/altr/zephyr_nios2f/Kconfig"
osource "/home/novello/zephyr3.7B/R5x_No/zephyr/soc/altr/qemu_nios2/Kconfig"
osource "/home/novello/zephyr3.7B/R5x_No/zephyr/soc/adi/max32/Kconfig"
```

## silabs/silabs_s2/efr32fg23/Kconfig.soc
```kconfig
# Silicon Labs EFR32MG21 (Mighty Gecko) MCU line

# Copyright (c) 2020 TriaGnoSys GmbH
# SPDX-License-Identifier: Apache-2.0

config SOC_SERIES_EFR32FG23
	bool
	select SOC_FAMILY_SILABS_S2
	help
	  EFR32FG23 Series MCU

config SOC_PART_NUMBER_EFR32FG23A010F512GM48
	bool
	select SOC_SERIES_EFR32FG23

config SOC_PART_NUMBER_EFR32FG23A010F512IM48
	bool
	select SOC_SERIES_EFR32FG23

config SOC_SERIES
	default "efr32fg23" if SOC_SERIES_EFR32FG23

config SOC   
	#default "efr32fg23a010f512im48" if SOC_PART_NUMBER_EFR32FG23A010F512IM48
	default "efr32fg23a010f512gm48" if SOC_PART_NUMBER_EFR32ZG23A010F512GM48

config SOC_PART_NUMBER
	#default "EFR32FG23A010F512IM48" if SOC_PART_NUMBER_EFR32FG23A010F512IM48
	default "EFR32FG23A010F512GM48" if SOC_PART_NUMBER_EFR32FG23A010F512GM48
```

## silabs/silabs_s2/efr32fg28/Kconfig.soc
```kconfig
# Silicon Labs EFR32MG24 (Mighty Gecko) MCU line

# Copyright (c) 2020 TriaGnoSys GmbH
# SPDX-License-Identifier: Apache-2.0

config SOC_SERIES_EFR32FG28
	bool
	select SOC_FAMILY_SILABS_S2
	help
	  EFR32FG28 Series MCU

config SOC_PART_NUMBER_EFR32FG28B312F1024IM68
	bool
	select SOC_SERIES_EFR32FG28

config SOC_PART_NUMBER_EFR32FG28A110F1024GM48
	bool
	select SOC_SERIES_EFR32FG28

config SOC_SERIES
	default "efr32fg28" if SOC_SERIES_EFR32FG28

config SOC
	default "efr32fg28b312f1024im68" if SOC_PART_NUMBER_EFR32FG28B312F1024IM68 
	#default "efr32fg28b320f1024im48" if SOC_PART_NUMBER_EFR32FG28A110F1024GM48

config SOC_PART_NUMBER
	default "EFR32FG28B312F1024IM68" if SOC_PART_NUMBER_EFR32FG28B312F1024IM68
	#default "EFR32FG28B320F1024IM48" if SOC_PART_NUMBER_EFR32FG28B320F1024IM48
```

## silabs/silabs_s2/efr32zg23/Kconfig.defconfig
```kconfig
# Silicon Labs EFR32MG21 (Might Gecko) series configuration options

# Copyright (c) 2020 TriaGnoSys GmbH
# SPDX-License-Identifier: Apache-2.0

if SOC_SERIES_EFR32ZG23

config NUM_IRQS
	# must be >= the highest interrupt number used
	default 75

config PM
	default n
	select COUNTER
	select UART_INTERRUPT_DRIVEN if SERIAL_SUPPORT_INTERRUPT

choice PM_POLICY
	default PM_POLICY_DEFAULT
	depends on PM
endchoice

endif # SOC_SERIES_EFR32ZG23
```

## silabs/silabs_s2/efr32zg23/Kconfig.soc
```kconfig
# Silicon Labs EFR32MG21 (Mighty Gecko) MCU line

# Copyright (c) 2020 TriaGnoSys GmbH
# SPDX-License-Identifier: Apache-2.0

config SOC_SERIES_EFR32ZG23
	bool
	select SOC_FAMILY_SILABS_S2
	help
	  EFR32FG23 Series MCU

config SOC_PART_NUMBER_EFR32ZG23B020F512IM48
	bool
	select SOC_SERIES_EFR32ZG23

config SOC_PART_NUMBER_EFR32ZG23B020F512GM48
	bool
	select SOC_SERIES_EFR32ZG23

config SOC_SERIES
	default "efr32zg23" if SOC_SERIES_EFR32ZG23

config SOC   
	#default "efr32fg23a010f512im48" if SOC_PART_NUMBER_EFR32FG23A010F512IM48
	default "efr32zg23b020f512im48" if SOC_PART_NUMBER_EFR32ZG23B020F512IM48

config SOC_PART_NUMBER
	#default "EFR32FG23A010F512IM48" if SOC_PART_NUMBER_EFR32FG23A010F512IM48
	default "EFR32ZG23B020F512IM48" if SOC_PART_NUMBER_EFR32ZG23B020F512IM48
```
